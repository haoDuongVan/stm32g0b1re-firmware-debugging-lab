/*
 * app_main.c
 *
 *  Created on: Jun 27, 2026
 *      Author: haodu
 */

/* Includes ------------------------------------------------------------------*/
#include "app_main.h"

#include "app_log.h"
#include "bl_flash_layout.h"
#include "main.h"

/* Private defines -----------------------------------------------------------*/

/*
 * Select application slot by build configuration.
 *
 * SlotA_Debug must define:
 *   APP_SLOT_A
 *   USER_VECT_TAB_ADDRESS
 *   VECT_TAB_OFFSET=0x00010000U
 *
 * SlotB_Debug must define:
 *   APP_SLOT_B
 *   USER_VECT_TAB_ADDRESS
 *   VECT_TAB_OFFSET=0x00040000U
 */
#if defined(APP_SLOT_A)

#define APP_SLOT_NAME                    "A"
#define APP_SLOT_BASE_ADDR               BL_SLOT_A_BASE_ADDR
#define APP_SLOT_END_ADDR                BL_SLOT_A_END_ADDR
#define APP_BOOT_TEST_TAG                "[TEST2]"
#define APP_BOOT_TEST_NAME               "app_slot_a_boot_check"

#elif defined(APP_SLOT_B)

#define APP_SLOT_NAME                    "B"
#define APP_SLOT_BASE_ADDR               BL_SLOT_B_BASE_ADDR
#define APP_SLOT_END_ADDR                BL_SLOT_B_END_ADDR
#define APP_BOOT_TEST_TAG                "[TEST3]"
#define APP_BOOT_TEST_NAME               "app_slot_b_boot_check"

#else
#error "APP_SLOT_A or APP_SLOT_B must be defined"
#endif

#ifndef USER_VECT_TAB_ADDRESS
#error "USER_VECT_TAB_ADDRESS must be defined for the application build"
#endif

#ifndef VECT_TAB_OFFSET
#error "VECT_TAB_OFFSET must be defined for the application build"
#endif

/*
 * VECT_TAB_OFFSET is used by generated SystemInit():
 *
 *   SCB->VTOR = FLASH_BASE | VECT_TAB_OFFSET;
 *
 * The linker script must also place the vector table at the same address.
 */
#if ((FLASH_BASE + VECT_TAB_OFFSET) != APP_SLOT_BASE_ADDR)
#error "VECT_TAB_OFFSET does not match APP_SLOT_BASE_ADDR"
#endif

// Define LED for heartbeat
#define APP_LED_GPIO_Port                GPIOA
#define APP_LED_Pin                      GPIO_PIN_5

// Define heartbeat period
#define APP_HEARTBEAT_PERIOD                  1000U

/* Private variables ---------------------------------------------------------*/
static uint8_t app_boot_check_done = 0U;

/*
 * Vector table symbol generated by the STM32 startup file.
 * Its address should match APP_SLOT_BASE_ADDR after linking.
 */
extern uint32_t g_pfnVectors[];

/* Private functions ---------------------------------------------------------*/

// Print boot information
static void AppMain_PrintBootLog(void)
{
  AppLog_Printf("\r\n");
  AppLog_Printf("[APP] STM32 Dual-Slot Test Application\r\n");
  AppLog_Printf("[APP] Project: 04_uart_bootloader\r\n");
  AppLog_Printf("[APP] Board: NUCLEO-G0B1RE\r\n");
  AppLog_Printf("[APP] System clock: %lu Hz\r\n",
                 (unsigned long)HAL_RCC_GetSysClockFreq());

  AppLog_Printf("[APP] slot_name=%s\r\n", APP_SLOT_NAME);
  AppLog_Printf("[APP] slot_base=0x%08lX\r\n",
                 (unsigned long)APP_SLOT_BASE_ADDR);
  AppLog_Printf("[APP] slot_end=0x%08lX\r\n",
                 (unsigned long)APP_SLOT_END_ADDR);
}

// Check whether vector table address and VTOR are correct (return 1 if OK, 0 if NG)
static int AppMain_CheckVectorTable(void)
{
  uint32_t vector_table_addr;
  uint32_t actual_vtor;

  vector_table_addr = (uint32_t)g_pfnVectors;
  actual_vtor = SCB->VTOR;

  if (vector_table_addr != APP_SLOT_BASE_ADDR) {
    return 0;
  }

  if (actual_vtor != APP_SLOT_BASE_ADDR) {
    return 0;
  }

  return 1;
}

// Run application boot self-check once
static void AppMain_RunBootCheck(void)
{
  uint32_t vector_table_addr;
  uint32_t expected_vtor;
  uint32_t actual_vtor;

  if (app_boot_check_done != 0U) {
    return;
  }

  app_boot_check_done = 1U;

  vector_table_addr = (uint32_t)g_pfnVectors;
  expected_vtor = APP_SLOT_BASE_ADDR;
  actual_vtor = SCB->VTOR;

  AppLog_Printf("\r\n");
  AppLog_Printf("[APP] vector_table=0x%08lX\r\n",
                 (unsigned long)vector_table_addr);
  AppLog_Printf("[APP] expected_vtor=0x%08lX\r\n",
                 (unsigned long)expected_vtor);
  AppLog_Printf("[APP] actual_vtor=0x%08lX\r\n",
                 (unsigned long)actual_vtor);

  if (AppMain_CheckVectorTable() != 0) {
    AppLog_Printf("[APP] vtor_check=OK\r\n");
    AppLog_Printf("%s %s PASS\r\n",
                   APP_BOOT_TEST_TAG,
                   APP_BOOT_TEST_NAME);
  } else {
    AppLog_Printf("[APP] vtor_check=NG\r\n");
    AppLog_Printf("%s %s FAIL\r\n",
                   APP_BOOT_TEST_TAG,
                   APP_BOOT_TEST_NAME);
  }
}

/* Function definitions ------------------------------------------------------*/

// Initialize application layer
void AppMain_Init(UART_HandleTypeDef *debug_uart)
{
  AppLog_Init(debug_uart);

  AppMain_PrintBootLog();
  AppMain_RunBootCheck();
}

// Toggle LED periodically
void AppMain_Run(void)
{
  static uint32_t last_tick = 0U;
  uint32_t now;

  now = HAL_GetTick();

  // Check heartbeat timing
  if ((now - last_tick) >= APP_HEARTBEAT_PERIOD) {
    // Update tick
    last_tick = now;

    // Toggle LED
    HAL_GPIO_TogglePin(APP_LED_GPIO_Port, APP_LED_Pin);
  }
}